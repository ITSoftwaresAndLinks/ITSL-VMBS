## conf/local.conf
```bitbake
#!/bin/bash
#
# ITSL-VMBS - Virtual Machine Backups Scripts
# Purpose:           local configuration
#
# Authors:           jurij.acalinovic@itsl.lu
#                    boris.acalinovic@gmail.com
#


#
# PILOT SERVER PARAMETERS
# ==================================================================================================================== #

# Absolute path to main logs file
LOGS_FILE_PATH="/var/logs/ITSL-VMBS.log"

# Absolute path to temporary logs file
# Used for results email
TEMP_FILE_PATH="/tmp/ITSL-VMBS-temp.log"

# Absolute path to ppk key file
# Used for plink without password use
PPK_KEY_PATH=""

#
# ESXi SOURCE PARAMETERS
# ==================================================================================================================== #

# FQDN or IP address of source ESXi server
SOURCE_ADDRESS=""

# Username
SOURCE_USERNAME=""

# Absolute path to datastore1
# Without ending /
SOURCE_DATASTORE1_PATH=""

# Absolute path to datastore2
# Without ending /
SOURCE_DATASTORE2_PATH=""

# Directory where to store ghettoVCB scripts
# Must be on datastore1, without ending /
SOURCE_GHETTOVCB_DIR="ghettoVCB"

# Filename to store VM list for ghettoVCB scripts
SOURCE_VM_LIST="vmbackups"

#
# ESXi TARGET PARAMETERS
# ==================================================================================================================== #

# FQDN or IP address of destination ESXi server
TARGET_ADDRESS=""

# Username
TARGET_USERNAME=""

# Absolute path to datastore1
# Without ending /
TARGET_DATASTORE1_PATH=""

# Absolute path to datastore2
# Without ending /
TARGET_DATASTORE2_PATH=""

#
# E-MAIL PARAMETERS
# ==================================================================================================================== #

# E-mail address where to send results
EMAIL_TO_ADDRESS=""

#
# SMS PARAMETERS (SENDED BY OVH)
# ==================================================================================================================== #

# Use SMS for errors ?
# Use 0 for no SMS, 1 for warning and critical, 2 for critical only
SMS_ON_ERROR="0"

# OVH base URL address
OVH_SMS_BASE_URL="https://www.ovh.com/cgi-bin/sms/http2sms.cgi"

# OVH account
OVH_SMS_ACCOUNT=""

# OVH login
OVH_SMS_LOGIN=""

# OVH password
OVH_SMS_PASSWORD=""

# OVH from
OVH_SMS_FROM=""

# OVH to number in international format
OVH_SMS_TO=""
```
